/*
 * boot_anim - the startup animation: the zeta function spiralling up its
 * own critical line.
 *
 * This header is the MATHS and the CHOREOGRAPHY - projection, smoothing,
 * colour, timeline. boot_anim.c is the drawing and the frame loop, and
 * boot_anim_curve.h is the curve itself, generated by
 * tools/gen_zeta_curve.py. Everything here is integer arithmetic with no
 * BSP, driver or framebuffer in sight, so a host suite can check all of it
 * on a laptop - nobody can eyeball a fixed-point projection and tell you
 * whether it is the right one.
 *
 * What is drawn: a floor gridded with the complex plane zeta's VALUE lives
 * in, t straight up for the height up the critical line, and
 * zeta(1/2 + it) for t from 0 to 35 plotted at height t. The five points
 * where it touches the t axis are the first five nontrivial zeros.
 *
 * A CAMERA and a SPACE, both keyframed: two independent small3dlib
 * transforms from boot_anim_keyframes[], generated from
 * boot_anim_timeline.json by tools/gen_boot_anim_timeline.py. Projection is
 * real perspective, not axonometric. One space-unit is one meter, and the
 * curve and grid's own coordinates ARE that space.
 *
 * The chip has no FPU, so everything is integers, in more than one scale -
 * mixing them up is the mistake to watch for:
 *
 *   Q12    a value of zeta. 4096 is 1.0, one unit of the floor grid.
 *   Q8     a height t. 256 is 1.0, and 35 * 256 still fits an int16.
 *   S3L_F  small3dlib's own fixed point (512 = 1.0) - meters once
 *          projected, camera/space transform numbers throughout, and a
 *          full turn of rotation.
 *   Q15    sines and cosines from this file's own trig table, used by the
 *          title's wobble/wave, not by the camera.
 */
#pragma once

#include <stdbool.h>
#include <stdint.h>

#define S3L_PIXEL_FUNCTION boot_anim_unused_pixel
#define S3L_RESOLUTION_X 368   /* GFX_WIDTH - see gfx.h; host compile
                                * constraint. */
#define S3L_RESOLUTION_Y 448   /* GFX_HEIGHT */
#define S3L_Z_BUFFER 0         /* no rasterizer, no depth buffer to keep */
#define S3L_SORT 0             /* no rasterizer, nothing to sort */
#define S3L_MAX_TRIANGES_DRAWN 1   /* the rasterizer is never called; small3dlib
                                    * still sizes an internal array off this */
#include "small3dlib.h"

static inline void boot_anim_unused_pixel(S3L_PixelInfo *pixel) { (void)pixel; }

#include "boot/boot_anim_curve.h"
#include "boot/boot_anim_timeline.h"
#include "gfx/gfx_font.h"
#include "util/intmath.h"
#include "util/tween.h"

#define BOOT_ANIM_Q    12
#define BOOT_ANIM_ONE  (1 << BOOT_ANIM_Q)   /* 4096 == 1.0 */
#define BOOT_ANIM_TQ   8                    /* t's own fixed point */

/*
 * The timeline
 *
 * A keyframe's position is in METERS, one space-unit to one. Rotation is
 * small3dlib's S3L_F-per-turn convention (one degree = S3L_F / 360) and
 * composes in Z, THEN X, THEN Y order, not X-Y-Z (S3L_Transform3D's own
 * comment in small3dlib.h). Scale is a plain multiplier with S3L_F
 * standing for 1.0, so an untouched keyframe reads back as 1,1,1.
 */

typedef struct {
    S3L_Transform3D camera;
    S3L_Transform3D space;
} boot_anim_timeline_state_t;

static inline uint8_t boot_anim_timeline_ease(uint8_t linear, uint8_t ease)
{
    switch (ease) {
    case BOOT_ANIM_EASE_OUT: return tween_ease_out(linear);
    case BOOT_ANIM_EASE_IN:  return tween_ease_in(linear);
    default:                 return linear;
    }
}

static inline S3L_Transform3D boot_anim_kf_transform(const int32_t pos[3],
                                                      const int32_t rot[3],
                                                      const int32_t scale[3])
{
    S3L_Transform3D t;
    t.translation.x = pos[0]; t.translation.y = pos[1]; t.translation.z = pos[2];
    t.rotation.x = rot[0];    t.rotation.y = rot[1];    t.rotation.z = rot[2];
    t.scale.x = scale[0];     t.scale.y = scale[1];     t.scale.z = scale[2];
    t.translation.w = t.rotation.w = t.scale.w = 0;
    return t;
}

static inline S3L_Transform3D boot_anim_lerp_transform(S3L_Transform3D a,
                                                        S3L_Transform3D b,
                                                        uint8_t u8)
{
    S3L_Transform3D t;
    t.translation.x = tween_lerp_i32(a.translation.x, b.translation.x, u8);
    t.translation.y = tween_lerp_i32(a.translation.y, b.translation.y, u8);
    t.translation.z = tween_lerp_i32(a.translation.z, b.translation.z, u8);
    t.rotation.x = tween_lerp_i32(a.rotation.x, b.rotation.x, u8);
    t.rotation.y = tween_lerp_i32(a.rotation.y, b.rotation.y, u8);
    t.rotation.z = tween_lerp_i32(a.rotation.z, b.rotation.z, u8);
    t.scale.x = tween_lerp_i32(a.scale.x, b.scale.x, u8);
    t.scale.y = tween_lerp_i32(a.scale.y, b.scale.y, u8);
    t.scale.z = tween_lerp_i32(a.scale.z, b.scale.z, u8);
    t.translation.w = t.rotation.w = t.scale.w = 0;
    return t;
}

/* Clamps ends, like boot_anim_sample. Table short, linear scan sufficient. */
static inline boot_anim_timeline_state_t boot_anim_timeline_sample(uint32_t now_ms)
{
    const boot_anim_keyframe_t *first = &boot_anim_keyframes[0];
    const boot_anim_keyframe_t *last =
        &boot_anim_keyframes[BOOT_ANIM_KEYFRAME_COUNT - 1];
    boot_anim_timeline_state_t s;

    if (now_ms <= first->ms || now_ms >= last->ms) {
        const boot_anim_keyframe_t *k = now_ms <= first->ms ? first : last;
        s.camera = boot_anim_kf_transform(k->camera_pos, k->camera_rot, k->camera_scale);
        s.space  = boot_anim_kf_transform(k->space_pos,  k->space_rot,  k->space_scale);
        return s;
    }

    int i = 1;
    while (boot_anim_keyframes[i].ms < now_ms) {
        i++;
    }
    const boot_anim_keyframe_t *a = &boot_anim_keyframes[i - 1];
    const boot_anim_keyframe_t *b = &boot_anim_keyframes[i];

    const uint8_t linear = tween_ramp(now_ms, a->ms, b->ms - a->ms);
    const uint8_t u8 = boot_anim_timeline_ease(linear, b->ease);

    const S3L_Transform3D ca = boot_anim_kf_transform(a->camera_pos, a->camera_rot, a->camera_scale);
    const S3L_Transform3D cb = boot_anim_kf_transform(b->camera_pos, b->camera_rot, b->camera_scale);
    const S3L_Transform3D sa = boot_anim_kf_transform(a->space_pos, a->space_rot, a->space_scale);
    const S3L_Transform3D sb = boot_anim_kf_transform(b->space_pos, b->space_rot, b->space_scale);

    s.camera = boot_anim_lerp_transform(ca, cb, u8);
    s.space  = boot_anim_lerp_transform(sa, sb, u8);
    return s;
}

/*
 * Trigonometry
 *
 * The sine table and the two functions on it serve the title's own wobble
 * and wave (boot_anim_title_wobble(), boot_anim_title_wave()) alone.
 * small3dlib owns the camera's rotation entirely.
 */

static const int16_t boot_anim_sin_quarter[65] = {
         0,    804,   1608,   2410,   3212,   4011,   4808,   5602,
      6393,   7179,   7962,   8739,   9512,  10278,  11039,  11793,
     12539,  13279,  14010,  14732,  15446,  16151,  16846,  17530,
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     32767,
};

/* Interpolated, not snapped. Table: 256 steps, 1.4 degrees. Snapping errors
 * compound. */
static inline int32_t boot_anim_sin_quadrant(uint32_t r)
{
    const uint32_t i = r >> 8;
    if (i >= 64) {
        return boot_anim_sin_quarter[64];
    }
    const int32_t a = boot_anim_sin_quarter[i];
    const int32_t b = boot_anim_sin_quarter[i + 1];
    return a + (((b - a) * (int32_t)(r & 0xFF)) >> 8);
}

/* sin of a 16-bit phase (65536 == one turn), Q15. */
static inline int32_t boot_anim_sin(uint16_t phase)
{
    const uint32_t quadrant = (uint32_t)phase >> 14;
    const uint32_t rest     = (uint32_t)phase & 0x3FFF;

    switch (quadrant) {
    case 0:  return  boot_anim_sin_quadrant(rest);
    case 1:  return  boot_anim_sin_quadrant(16384u - rest);
    case 2:  return -boot_anim_sin_quadrant(rest);
    default: return -boot_anim_sin_quadrant(16384u - rest);
    }
}

static inline int32_t boot_anim_cos(uint16_t phase)
{
    return boot_anim_sin((uint16_t)(phase + 16384u));
}

/*
 * The projection
 *
 * Perspective, via small3dlib: `boot_anim_view_t` is the composed
 * space-then-camera matrix plus focal length, so a point costs one
 * matrix-vector multiply and one divide - a per-point cost an axonometric
 * projection does not have, accepted for real foreshortening by distance.
 *
 * Orthographic is not a second code path to build: small3dlib treats
 * focalLength == 0 as orthographic, zoom coming from the camera's own
 * scale, so it is BOOT_ANIM_CAMERA_FOCAL set to 0.
 */

#define BOOT_ANIM_T_MAX 126    /* the top of the climb            */

/* KEEP: Must match tools/gen_zeta_curve.py's PHASE1_T_MAX. */
#define BOOT_ANIM_T_MAX_PHASE1 35

/* RINGS is how far the fade reaches, not the floor size - quarter-unit
 * spacing (not whole) so it reads as a dense ripple rather than
 * individually countable bands. Both generated: RINGS in
 * boot_anim_timeline.h, STEP_Q12 with it. FADE is its own name for what
 * boot_anim_grid_alpha() means, but must equal RINGS exactly - short of
 * it is a hard edge, past it divides by a count nothing reaches. */
#define BOOT_ANIM_GRID_FADE BOOT_ANIM_GRID_RINGS

#define BOOT_ANIM_ZETA_TO_S3L(v) ((v) >> 3)

/* Preserved as Q8 multiplier for SPIRAL effect. */
#define BOOT_ANIM_T_TO_S3L_Q8 132

static inline int32_t boot_anim_t_to_s3l(int32_t t_q8)
{
    return (t_q8 * BOOT_ANIM_T_TO_S3L_Q8) >> 8;
}

/* see boot_anim_view() below; S3L_perspectiveDivide() needs focal length */
typedef struct {
    S3L_Mat4 matrix;
    S3L_Unit focal;
} boot_anim_view_t;

static inline boot_anim_view_t boot_anim_view(int w, int h, uint32_t now_ms)
{
    (void)w;
    (void)h;

    const boot_anim_timeline_state_t st = boot_anim_timeline_sample(now_ms);

    S3L_Mat4 space_mat, cam_mat;
    S3L_makeWorldMatrix(st.space, space_mat);
    S3L_makeCameraMatrix(st.camera, cam_mat);
    S3L_mat4Xmat4(space_mat, cam_mat);

    boot_anim_view_t v;
    S3L_mat4Copy(space_mat, v.matrix);
    v.focal = BOOT_ANIM_CAMERA_FOCAL;
    return v;
}

/* CAMERA space transform; boot_anim_project() refactored for z check. Q12
 * re/im, Q8 t. Uses boot_anim_curve[] as fixed point in small3dlib. */
static inline S3L_Vec4 boot_anim_to_camera_space(int32_t re_q12,
                                                  int32_t im_q12,
                                                  int32_t t_q8,
                                                  const boot_anim_view_t *view)
{
    S3L_Vec4 p;
    p.x = BOOT_ANIM_ZETA_TO_S3L(re_q12);
    p.y = boot_anim_t_to_s3l(t_q8);
    p.z = BOOT_ANIM_ZETA_TO_S3L(im_q12);
    p.w = S3L_F;

    S3L_vec3Xmat4(&p, (S3L_Unit (*)[4])view->matrix);
    return p;
}

static inline void boot_anim_camera_to_screen(S3L_Vec4 p, S3L_Unit focal,
                                              int *screen_x, int *screen_y)
{
    p.z = S3L_nonZero(p.z);
    S3L_perspectiveDivide(&p, focal);

    /* NOT S3L_mapProjectionPlaneToScreen(): its S3L_ScreenCoord defaults
     * to int16_t, and S3L_USE_WIDER_TYPES would widen S3L_Unit itself to
     * int64_t everywhere - a real cost with no native 64-bit ALU. This
     * repeats its formula but with just the multiply done in int64_t: a
     * near-camera point's already-divided p.x/p.y can be large enough to
     * overflow a 32-bit product here even though the final on/off-panel
     * result never does - gfx.c's clip_line() leans on the same trick. */
    *screen_x = (int)(S3L_HALF_RESOLUTION_X +
        ((int64_t)p.x * S3L_HALF_RESOLUTION_X) / S3L_F);
    *screen_y = (int)(S3L_HALF_RESOLUTION_Y -
        ((int64_t)p.y * S3L_HALF_RESOLUTION_X) / S3L_F);
}

static inline void boot_anim_project(int32_t re_q12, int32_t im_q12,
                                     int32_t t_q8,
                                     const boot_anim_view_t *view,
                                     int *screen_x, int *screen_y)
{
    const S3L_Vec4 p = boot_anim_to_camera_space(re_q12, im_q12, t_q8, view);
    boot_anim_camera_to_screen(p, view->focal, screen_x, screen_y);
}

/* Small fraction of a meter - see boot_anim_project_segment_cs() */
#define BOOT_ANIM_NEAR_Z (S3L_F / 10)

/* Draws if point is in front; checks visibility, avoids invalid coordinates. */
static inline bool boot_anim_project_point(int32_t re_q12, int32_t im_q12,
                                           int32_t t_q8,
                                           const boot_anim_view_t *view,
                                           int *screen_x, int *screen_y)
{
    const S3L_Vec4 p = boot_anim_to_camera_space(re_q12, im_q12, t_q8, view);
    if (p.z <= BOOT_ANIM_NEAR_Z) {
        return false;
    }
    boot_anim_camera_to_screen(p, view->focal, screen_x, screen_y);
    return true;
}

/* Clips to near plane; avoids screen wrap. Returns false if segment is at or
 * behind the plane. */
static inline bool boot_anim_project_segment_cs(
    S3L_Vec4 p0, S3L_Vec4 p1, const boot_anim_view_t *view,
    int *ax, int *ay, int *bx, int *by)
{
    const bool front0 = p0.z > BOOT_ANIM_NEAR_Z;
    const bool front1 = p1.z > BOOT_ANIM_NEAR_Z;

    if (!front0 && !front1) {
        return false;
    }

    if (front0 != front1) {
        /* Replace endpoint with crossing point using linear interpolation in
         * camera space. */
        S3L_Vec4 *behind = front0 ? &p1 : &p0;
        const S3L_Vec4 *front = front0 ? &p0 : &p1;
        const int64_t frac_q16 =
            ((int64_t)(BOOT_ANIM_NEAR_Z - behind->z) << 16) /
            (front->z - behind->z);

        behind->x += (int32_t)(((int64_t)(front->x - behind->x) *
                                frac_q16) >> 16);
        behind->y += (int32_t)(((int64_t)(front->y - behind->y) *
                                frac_q16) >> 16);
        behind->z = BOOT_ANIM_NEAR_Z;
    }

    boot_anim_camera_to_screen(p0, view->focal, ax, ay);
    boot_anim_camera_to_screen(p1, view->focal, bx, by);
    return true;
}

/* See boot_anim_project_segment_cs() for clipping. draw_curve() keeps points
 * in camera space. */
static inline bool boot_anim_project_segment(
    int32_t re0, int32_t im0, int32_t t0,
    int32_t re1, int32_t im1, int32_t t1,
    const boot_anim_view_t *view,
    int *ax, int *ay, int *bx, int *by)
{
    return boot_anim_project_segment_cs(
        boot_anim_to_camera_space(re0, im0, t0, view),
        boot_anim_to_camera_space(re1, im1, t1, view),
        view, ax, ay, bx, by);
}

/*
 * The wave
 *
 * A genuine radial sine wave - height(r, t) = amplitude * sin(2*pi*r /
 * wavelength - 2*pi*t / period) - rather than a travelling front with a
 * decaying trail: sin() is ALREADY periodic in r and the floor is ALREADY
 * rings at fixed radii, so every ring's own crest falls out of the one
 * formula with no "which rings are lit yet" bookkeeping.
 *
 * Per VERTEX for a spoke, ONCE per ring for a ring's own circle - see
 * draw_grid_circle()/draw_grid_spoke() in boot_anim.c.
 */

#define BOOT_ANIM_WAVE_ENVELOPE_RAMP_MS 500

/* BOOT_ANIM_WAVE_IN_MS, BOOT_ANIM_WAVE_ENVELOPE_RAMP_MS,
 * BOOT_ANIM_WAVE_OUT_MS define shape. Q0 scales strength. Timing independent. */
static inline uint8_t boot_anim_wave_envelope(uint32_t now_ms)
{
    const uint8_t in = tween_ramp(now_ms, BOOT_ANIM_WAVE_IN_MS,
                                  BOOT_ANIM_WAVE_ENVELOPE_RAMP_MS);
    const uint8_t out = (uint8_t)(255u - tween_ramp(now_ms,
        BOOT_ANIM_WAVE_OUT_MS, BOOT_ANIM_WAVE_ENVELOPE_RAMP_MS));

    return (in < out) ? in : out;
}

static inline int32_t boot_anim_zeta_to_t_q8(int32_t zeta_q12)
{
    return (int32_t)(((int64_t)zeta_q12 << 5) / BOOT_ANIM_T_TO_S3L_Q8);
}

/* Zero amp or wavelength zeroes lift. Period 0 freezes pattern (a static
 * ripple, not a crash) rather than dividing by zero. Shape parameters are
 * passed in rather than read from the generated constants directly, so a
 * test can drive the ripple with values of its own choosing regardless of
 * the compiled seed - the same "pass the environment in" split
 * docs/Testing-Guide.md asks for. */
static inline int32_t boot_anim_wave_height(int32_t r_q12, uint32_t now_ms,
                                            int32_t amp_q12,
                                            int32_t wavelength_q12,
                                            uint32_t period_ms)
{
    if (amp_q12 == 0 || wavelength_q12 <= 0) {
        return 0;
    }

    const uint32_t space_phase =
        (uint32_t)(((int64_t)r_q12 * 65536) / wavelength_q12);
    const uint32_t time_phase = (period_ms == 0) ? 0u :
        (uint32_t)(((uint64_t)(now_ms % period_ms) * 65536u) / period_ms);

    /* Wraps mod 65536 by uint16_t truncation */
    const uint16_t phase = (uint16_t)(space_phase - time_phase);
    const int32_t sin_q15 = boot_anim_sin(phase);

    const int32_t amp_zeta_q12 =
        (int32_t)(((int64_t)amp_q12 * sin_q15) >> 15);

    return boot_anim_zeta_to_t_q8(amp_zeta_q12);
}

/*
 * Smoothing
 *
 * 205 samples of a curve that crosses most of the screen is a chord every six
 * pixels or so, and at that size a polyline reads as a polyline - the tight
 * turns near the axis visibly have corners. Rather than carry more samples,
 * the ones there are get drawn as a spline.
 */

#define BOOT_ANIM_SPLINE_STEPS 4

#define BOOT_ANIM_LOD_CHORD_PX 3

#define BOOT_ANIM_LOD_STRIDE2_PX 192
#define BOOT_ANIM_LOD_STRIDE4_PX 96

#define BOOT_ANIM_DISSOLVE_HALF_LEVEL   4
#define BOOT_ANIM_DISSOLVE_COARSE_LEVEL 8

typedef struct {
    int32_t re, im;   /* Q12 */
    int32_t t;        /* Q8  */
} boot_anim_pt_t;

/* A quadratic B-spline through c0, c1, c2 at `t_q12` for BOOT_ANIM_ONE.
 * Avoids Catmull-Rom's overshoot, staying convex. Quadratic for simpler
 * normalization (shift vs divide). */
static inline boot_anim_pt_t boot_anim_spline(boot_anim_pt_t c0,
                                              boot_anim_pt_t c1,
                                              boot_anim_pt_t c2,
                                              int32_t t_q12)
{
    /* 32-bit throughout, deliberately not util/fixed.h's widening helpers:
     * the operands are sized so the product cannot overflow an int32, on a
     * path that runs several thousand times a frame. */
    const int32_t u  = BOOT_ANIM_ONE - t_q12;
    const int32_t w0 = (u * u) >> BOOT_ANIM_Q;
    const int32_t w2 = (t_q12 * t_q12) >> BOOT_ANIM_Q;

    /* Weights sum to 2.0 by construction, so the middle one is never
     * computed from its own polynomial and cannot drift from the other
     * two. */
    const int32_t w1 = 2 * BOOT_ANIM_ONE - w0 - w2;

    boot_anim_pt_t p;
    p.re = (w0 * c0.re + w1 * c1.re + w2 * c2.re) >> (BOOT_ANIM_Q + 1);
    p.im = (w0 * c0.im + w1 * c1.im + w2 * c2.im) >> (BOOT_ANIM_Q + 1);
    p.t  = (w0 * c0.t  + w1 * c1.t  + w2 * c2.t ) >> (BOOT_ANIM_Q + 1);
    return p;
}

/* Same quadratic B-spline as boot_anim_spline() above, on points already
 * in CAMERA space, avoiding a transform per sub-point. Exact, not
 * approximate: boot_anim_to_camera_space() is an affine map and this
 * spline's weights sum to a constant, so it commutes with this
 * combination exactly (not bit-exact in fixed point, but well under a
 * pixel). Weighted sum is int64_t, unlike boot_anim_spline()'s 32-bit: a
 * camera-space coordinate has no known-small-range promise a raw
 * curve-table value does. */
static inline S3L_Vec4 boot_anim_spline_cs(S3L_Vec4 c0, S3L_Vec4 c1,
                                           S3L_Vec4 c2, int32_t t_q12)
{
    const int32_t u  = BOOT_ANIM_ONE - t_q12;
    const int32_t w0 = (u * u) >> BOOT_ANIM_Q;
    const int32_t w2 = (t_q12 * t_q12) >> BOOT_ANIM_Q;
    const int32_t w1 = 2 * BOOT_ANIM_ONE - w0 - w2;

    S3L_Vec4 p;
    p.x = (S3L_Unit)(((int64_t)w0 * c0.x + (int64_t)w1 * c1.x +
                       (int64_t)w2 * c2.x) >> (BOOT_ANIM_Q + 1));
    p.y = (S3L_Unit)(((int64_t)w0 * c0.y + (int64_t)w1 * c1.y +
                       (int64_t)w2 * c2.y) >> (BOOT_ANIM_Q + 1));
    p.z = (S3L_Unit)(((int64_t)w0 * c0.z + (int64_t)w1 * c1.z +
                       (int64_t)w2 * c2.z) >> (BOOT_ANIM_Q + 1));
    p.w = S3L_F;
    return p;
}

static inline bool boot_anim_screen_chord_lt(S3L_Vec4 a, S3L_Vec4 c,
                                             const boot_anim_view_t *view,
                                             int32_t px)
{
    if (a.z <= BOOT_ANIM_NEAR_Z || c.z <= BOOT_ANIM_NEAR_Z) {
        return false;
    }
    const int32_t dx = im_abs((int)(a.x - c.x));
    const int32_t dy = im_abs((int)(a.y - c.y));
    const int64_t m = (int64_t)dx + dy;
    if (view->focal == 0) {
        return m * S3L_HALF_RESOLUTION_X < (int64_t)px * S3L_F;
    }
    const int32_t zmin = a.z < c.z ? a.z : c.z;
    return m * view->focal * S3L_HALF_RESOLUTION_X <
           (int64_t)px * zmin * S3L_F;
}

/* Do NOT subdivide if span ends within BOOT_ANIM_LOD_CHORD_PX. Uses
 * boot_anim_screen_chord_lt(). */
static inline int boot_anim_curve_lod_steps(S3L_Vec4 a, S3L_Vec4 c,
                                            const boot_anim_view_t *view)
{
    return boot_anim_screen_chord_lt(a, c, view, BOOT_ANIM_LOD_CHORD_PX)
        ? 1 : BOOT_ANIM_SPLINE_STEPS;
}

/* Clamping pins spline to ends. Repeated first control point starts first
 * span at first sample. */
static inline boot_anim_pt_t boot_anim_sample(int i)
{
    if (i < 0) {
        i = 0;
    } else if (i >= BOOT_ANIM_CURVE_POINTS) {
        i = BOOT_ANIM_CURVE_POINTS - 1;
    }
    boot_anim_pt_t p;
    p.re = boot_anim_curve[i].re;
    p.im = boot_anim_curve[i].im;
    p.t  = boot_anim_curve[i].t;
    return p;
}

static inline int boot_anim_lod_stride_for_extent(int32_t manhattan_px)
{
    if (manhattan_px < BOOT_ANIM_LOD_STRIDE4_PX) {
        return 4;
    }
    if (manhattan_px < BOOT_ANIM_LOD_STRIDE2_PX) {
        return 2;
    }
    return 1;
}

static inline int boot_anim_curve_stride(const boot_anim_view_t *view)
{
    static const int probe_idx[3] = {
        0, BOOT_ANIM_CURVE_POINTS / 2, BOOT_ANIM_CURVE_POINTS - 1,
    };
    int min_x = 0, max_x = 0, min_y = 0, max_y = 0;

    for (int k = 0; k < 3; k++) {
        const boot_anim_pt_t p = boot_anim_sample(probe_idx[k]);
        int sx, sy;
        if (!boot_anim_project_point(p.re, p.im, p.t, view, &sx, &sy)) {
            return 1;
        }
        if (k == 0 || sx < min_x) min_x = sx;
        if (k == 0 || sx > max_x) max_x = sx;
        if (k == 0 || sy < min_y) min_y = sy;
        if (k == 0 || sy > max_y) max_y = sy;
    }

    return boot_anim_lod_stride_for_extent((max_x - min_x) + (max_y - min_y));
}

/*
 * The choreography
 *
 * Every phase is a function of milliseconds since power-up rather than of a
 * frame counter, so the animation lasts five seconds whatever the frame rate
 * turns out to be - and it does move, because a frame costs a full-screen
 * transfer plus however much curve there is to draw by then.
 */

/* A FRACTION, not a pixel count: arms have different lengths. */
static inline uint8_t boot_anim_axis_reach(uint32_t now_ms)
{
    return tween_ease_out(tween_ramp(now_ms, 0, BOOT_ANIM_AXES_MS));
}

/* Ring fades multiply IN and OUT - depth cue on a projection with no
 * real perspective. Floor is backdrop: full strength competes with the
 * curve and wins, so BOOT_ANIM_GRID_MAX (generated) stays low - not
 * forever (see boot_anim_grid_climb() below), since that holds only
 * while the curve is full-size. One clock drives opacity and whitening
 * together: hue alone fixes muddiness, not peak brightness. Climbs from
 * the floor's appearance to BOOT_ANIM_MS, linear so it reads as steadily
 * adding up. */
static inline uint8_t boot_anim_grid_climb(uint32_t now_ms)
{
    return tween_ramp(now_ms, BOOT_ANIM_GRID_START_MS,
                      BOOT_ANIM_MS - BOOT_ANIM_GRID_START_MS);
}

static inline uint8_t boot_anim_grid_alpha(uint32_t now_ms, int ring)
{
    if (ring >= BOOT_ANIM_GRID_FADE) {
        return 0;
    }
    const uint32_t start = BOOT_ANIM_GRID_START_MS +
                           (uint32_t)ring * BOOT_ANIM_GRID_RING_MS;
    const uint32_t arrived = tween_ramp(now_ms, start,
                                            BOOT_ANIM_GRID_FADE_MS);

    /* left/FADE, bounded rings. Squared dims too much. Linear keeps depth. */
    const uint32_t left = (uint32_t)(BOOT_ANIM_GRID_FADE - ring);
    const uint32_t ceiling = (uint32_t)tween_lerp_i32(
        BOOT_ANIM_GRID_MAX, BOOT_ANIM_GRID_CEILING_MAX,
        boot_anim_grid_climb(now_ms));
    const uint32_t near = left * ceiling / (uint32_t)BOOT_ANIM_GRID_FADE;

    return (uint8_t)((arrived * near) / 255u);
}

static inline uint8_t boot_anim_grid_spoke_reach(uint32_t now_ms)
{
    return tween_ramp(now_ms, BOOT_ANIM_GRID_SPOKE_START_MS,
                      BOOT_ANIM_GRID_SPOKE_DRAW_MS);
}

/* NOT linear in `reach`: a point projects to roughly 1/r on screen, so
 * linear-in-radius puts almost all screen-space growth in the first few
 * percent of the reveal. Interpolating 1/target keeps growth roughly
 * even instead. Below `near`, stays linear-in-radius: 1/target needs a
 * positive radius to anchor to, and 1/0 does not exist. Algebraically:
 * target = (near*far) / (far - (far-near)*frac). Plain math (not
 * boot_anim.c) so it is host-testable - see suite_boot_anim.c. */
static inline int32_t boot_anim_spoke_reveal_target(int32_t near,
                                                     int32_t far,
                                                     uint8_t reach)
{
    if (reach == 0) {
        return 0;
    }
    if (reach >= 255 || far <= 0) {
        return far;
    }

    const int32_t r0 = (int32_t)(((int64_t)near * 255) / far);
    if (reach <= r0 || r0 <= 0) {
        return (int32_t)(((int64_t)far * reach) / 255);
    }

    const int32_t frac_q8 =
        (int32_t)(((int64_t)(reach - r0) << 8) / (255 - r0));
    const int64_t denom_q8 =
        ((int64_t)far << 8) - (int64_t)(far - near) * frac_q8;
    if (denom_q8 <= 0) {
        return far;   /* degenerate - clamp rather than divide by <=0 */
    }
    return (int32_t)((((int64_t)near * far) << 8) / denom_q8);
}

static inline uint8_t boot_anim_grid_whiten(uint32_t now_ms)
{
    return (uint8_t)tween_lerp_i32(0, BOOT_ANIM_GRID_WHITEN_MAX,
                                   boot_anim_grid_climb(now_ms));
}

/* "Phase 1 must finish before the picture starts fading" is enforced by
 * tools/gen_boot_anim_timeline.py's validate() now that these timings are
 * generated data, not source. */

/*
 * The title
 *
 * "Autana", laid out in the VIEWER'S frame rather than the panel's: the
 * board is held a quarter turn from its native upright, so "left to right"
 * means that to whoever holds it. BOOT_ANIM_TITLE_VIEW_W/H below are that
 * frame; boot_anim.c turns a point in it into the panel coordinate
 * gfx_text_font() wants. Nothing else in this file leaves the panel's own
 * raw coordinates.
 *
 * A letter's wobble winds down in frequency as it shrinks in amplitude, so
 * it settles rather than sliding to a stop.
 */

#define BOOT_ANIM_TITLE     "Autana"
#define BOOT_ANIM_TITLE_LEN 6

#define BOOT_ANIM_TITLE_GAP   3    /* extra px of tracking between glyphs */

typedef enum {
    BOOT_ANIM_TITLE_FONT_LMROMAN_40 = 0,
    BOOT_ANIM_TITLE_FONT_8X8        = 1,
} boot_anim_title_font_id_t;

#define BOOT_ANIM_TITLE_VIEW_W 448
#define BOOT_ANIM_TITLE_VIEW_H 368

/* BOOT_ANIM_TITLE_VIEW_X/Y are authored (title_x_px/title_height_px in
 * the JSON, generated into boot_anim_timeline.h), not fixed here - each a
 * knob rather than a value someone edits this comment to change. Their
 * defaults derive from a golden-rectangle spiral inscribed in the frame;
 * see git history for the construction if the geometry is ever
 * revisited. test_the_title_stays_on_the_panel_once_visible() pins the
 * result within BOOT_ANIM_TITLE_VIEW_W. */

static inline int boot_anim_title_wobble(int32_t d_q12)
{
    if (d_q12 <= 0) {
        return 0;
    }
    const int32_t d2_q12 = (d_q12 * d_q12) >> BOOT_ANIM_Q;

    const uint16_t phase = (uint16_t)
        ((d2_q12 * BOOT_ANIM_TITLE_TURNS_PHASE) >> BOOT_ANIM_Q);

    const int32_t amp = (BOOT_ANIM_TITLE_AMPLITUDE_PX * d_q12) >> BOOT_ANIM_Q;
    return (int)((amp * boot_anim_sin(phase)) >> 15);
}

typedef struct {
    int x, y;   /* pixels */
} boot_anim_title_pos_t;

/* Amplitude under 22, don't hurt legibility. In sequence, staggered phase.
 * See boot_anim_timeline.h. */

/* Decay by ear, linear ramp, no easing. */
static inline uint8_t boot_anim_title_wave_reach(uint32_t now_ms)
{
    return (uint8_t)(255u - tween_ramp(now_ms, BOOT_ANIM_TITLE_WAVE_OUT_MS,
                                       BOOT_ANIM_TITLE_WAVE_FADE_MS));
}

static inline int boot_anim_title_wave(int i, uint32_t now_ms)
{
    const uint32_t t = (now_ms + (uint32_t)i * BOOT_ANIM_TITLE_WAVE_STAGGER_MS)
                       % BOOT_ANIM_TITLE_WAVE_PERIOD_MS;
    const uint16_t phase =
        (uint16_t)((t * 65536u) / BOOT_ANIM_TITLE_WAVE_PERIOD_MS);
    const int32_t amp = (BOOT_ANIM_TITLE_WAVE_AMPLITUDE_PX *
                         boot_anim_title_wave_reach(now_ms)) / 255;
    return (int)((amp * boot_anim_sin(phase)) >> 15);
}

/* Row starts at a FIXED BOOT_ANIM_TITLE_VIEW_X/Y, not read live: the
 * target a letter flies toward has to stay put for the whole flight.
 * final_x sums each letter's real advance via gfx_font_text_width(), not
 * `i * cell_w`: a fixed per-cell reckoning is wrong for a proportional
 * font, where narrow/wide glyphs do not share one width - see
 * test_final_x_matches_the_advance_sum() in suite_boot_anim.c. */
static inline boot_anim_title_pos_t boot_anim_title_letter(
    const gfx_font_t *font, int i, uint32_t now_ms)
{
    const uint32_t start = BOOT_ANIM_TITLE_START_MS +
                           (uint32_t)i * BOOT_ANIM_TITLE_STAGGER_MS;
    const uint8_t u8 = tween_ease_out(
        tween_ramp(now_ms, start, BOOT_ANIM_TITLE_FLIGHT_MS));

    const int prefix_w = gfx_font_text_width(font, BOOT_ANIM_TITLE, i,
                                             BOOT_ANIM_TITLE_SCALE);
    const int final_x = BOOT_ANIM_TITLE_VIEW_X + prefix_w +
                        i * BOOT_ANIM_TITLE_GAP;
    const int start_x = final_x - BOOT_ANIM_TITLE_ENTRY_PX;

    boot_anim_title_pos_t p;
    p.x = tween_lerp_i32(start_x, final_x, u8);

    const int32_t d_q12 = BOOT_ANIM_ONE - tween_lerp_i32(0, BOOT_ANIM_ONE, u8);
    p.y = BOOT_ANIM_TITLE_VIEW_Y + boot_anim_title_wobble(d_q12) +
          boot_anim_title_wave(i, now_ms);
    return p;
}

/* Swap and negate offset for shadow. Pure, host-testable function. */
static inline void boot_anim_title_shadow_offset(int dx, int dy,
                                                  int *panel_dx, int *panel_dy)
{
    *panel_dx = -dy;
    *panel_dy = dx;
}

/* "Every letter must have landed before the fade" is checked by
 * gen_boot_anim_timeline.py as a WARNING, not a refusal to emit: unlike
 * the curve still drawing when the fade starts (unambiguously broken), a
 * letter still arriving as the picture dissolves might be wanted. */

/*
 * Colour
 *
 * The panel is an AMOLED: an unlit pixel is genuinely off, not a backlight
 * leaking through black, so saturated colour on a true black field is the
 * one thing this screen does that an LCD cannot. Hence a hue wheel rather
 * than a house colour - the curve turns most of the way round it on the way
 * up, so height reads as colour.
 *
 * Only the HUE is computed here: brightness and desaturation come out as
 * amounts for gfx_color_mix() to apply.
 */

/* A whole turn: six sectors of 256, so the sector is a shift and the ramp
 * within one is a byte. */
#define BOOT_ANIM_HUE_TURN 1536

/* 0xRRGGBB at full saturation and full brightness. */
static inline uint32_t boot_anim_hue_rgb(int hue)
{
    hue %= BOOT_ANIM_HUE_TURN;
    if (hue < 0) {
        hue += BOOT_ANIM_HUE_TURN;
    }

    const uint32_t ramp = (uint32_t)(hue & 0xFF);   /* rising edge, 0..255 */
    const uint32_t fall = 255u - ramp;

    switch (hue >> 8) {
    case 0:  return (0xFFu << 16) | (ramp << 8);            /* red     -> yellow  */
    case 1:  return (fall << 16) | (0xFFu << 8);            /* yellow  -> green   */
    case 2:  return (0xFFu << 8) | ramp;                    /* green   -> cyan    */
    case 3:  return (fall << 8) | 0xFFu;                    /* cyan    -> blue    */
    case 4:  return (ramp << 16) | 0xFFu;                   /* blue    -> magenta */
    default: return (0xFFu << 16) | fall;                   /* magenta -> red     */
    }
}

/* Grid hues shift. Floor stays still. Rings change in waves. GENERATED:
 * BOOT_ANIM_GRID_HUE_MS/HUE_SPREAD. */

static inline int boot_anim_grid_hue(uint32_t now_ms, int ring)
{
    const uint32_t turn = (now_ms % BOOT_ANIM_GRID_HUE_MS) *
                          BOOT_ANIM_HUE_TURN / BOOT_ANIM_GRID_HUE_MS;
    return (int)turn + ring * BOOT_ANIM_GRID_HUE_SPREAD;
}

/* Fraction of LENGTH, not of t: samples are constant-spaced on screen, so
 * constant walk rate is constant pen speed. Phase 1 preserves this
 * file's original drawing exactly (same fraction of a now-longer table,
 * same wall-clock rate). Phase 2 finishes at its own authored
 * PEN_FINISH_MS, not coupled to FADE_START_MS, so it is not forced to
 * finish exactly when the dissolve begins. Left uncapped against the
 * fade: the generator only warns, since a curve still drawing as it
 * dissolves might be wanted. */
#define BOOT_ANIM_CURVE_PHASE1_FRACTION \
    ((int32_t)(((int64_t)(BOOT_ANIM_CURVE_PHASE1_POINTS - 1) * BOOT_ANIM_ONE) / \
               (BOOT_ANIM_CURVE_POINTS - 1)))

static inline int32_t boot_anim_pen(uint32_t now_ms)
{
    const uint32_t phase1_end_ms = BOOT_ANIM_PEN_START_MS + BOOT_ANIM_PEN_MS;

    if (now_ms <= phase1_end_ms) {
        const uint8_t linear = tween_ramp(now_ms, BOOT_ANIM_PEN_START_MS,
                                              BOOT_ANIM_PEN_MS);
        return tween_lerp_i32(0, BOOT_ANIM_CURVE_PHASE1_FRACTION, linear);
    }

    const uint8_t linear2 = tween_ramp(
        now_ms, phase1_end_ms, BOOT_ANIM_PEN_FINISH_MS - phase1_end_ms);
    return tween_lerp_i32(BOOT_ANIM_CURVE_PHASE1_FRACTION, BOOT_ANIM_ONE,
                          linear2);
}

static inline int32_t boot_anim_colour_progress(uint32_t now_ms)
{
    const int32_t span        = (int32_t)(BOOT_ANIM_CURVE_POINTS - 1);
    const int32_t phase1_span = (int32_t)(BOOT_ANIM_CURVE_PHASE1_POINTS - 1);
    return (int32_t)(((int64_t)boot_anim_pen(now_ms) * span) / phase1_span);
}

static inline uint8_t boot_anim_ink(uint32_t now_ms)
{
    return (uint8_t)(255u - tween_ramp(now_ms, BOOT_ANIM_FADE_START_MS,
                                           BOOT_ANIM_MS - BOOT_ANIM_FADE_START_MS));
}

/* Crossfade to the photograph, 0..255, over BOOT_ANIM_IMAGE_START_MS/
 * FADE_MS. Plain tween_ramp(), not eased: ease_out(r) + ease_out(255-r)
 * is NOT 255 at every r, so easing either half of a cross-dissolve makes
 * the midpoint read brighter than either end - linear is what keeps the
 * two halves summing to one whole picture throughout. */
static inline uint8_t boot_anim_image_reveal(uint32_t now_ms)
{
    return tween_ramp(now_ms, BOOT_ANIM_IMAGE_START_MS,
                      BOOT_ANIM_IMAGE_FADE_MS);
}

/* Exact complement of boot_anim_image_reveal(), not a second
 * tween_ramp(): two separately-rounded ramps are not guaranteed to sum
 * to 255 the way a value and its subtraction are. A deliberate second
 * visibility clock (unlike this file's one-multiply design - see
 * scale8()), scoped to floor/axes/curve/zeros, not the title. Realised
 * in boot_anim.c as composite order: draw_* calls mix off constant
 * black with no framebuffer read, so a fading alpha over the photo
 * would paint an opaque scratch instead. */
static inline uint8_t boot_anim_scene_reach(uint32_t now_ms)
{
    return (uint8_t)(255u - boot_anim_image_reveal(now_ms));
}

#define BOOT_ANIM_HUE_START 875    /* azure, at the foot of the climb */
#define BOOT_ANIM_HUE_SWEEP 1200   /* most of a turn by the top       */

/* Five pens show gamut with colour wash */
#define BOOT_ANIM_TRAILS    5

/* How far apart the pens run, as a Q12 fraction of the whole curve. */
#define BOOT_ANIM_TRAIL_GAP 768

#define BOOT_ANIM_TRAIL_SHIFT 10
#define BOOT_ANIM_TRAIL_Q12   (1 << BOOT_ANIM_TRAIL_SHIFT)

/* Heavy strokes drawn wider for visibility. */
#define BOOT_ANIM_FAT_TRAIL 150
#define BOOT_ANIM_FAT_WIDTH 3

static inline int32_t boot_anim_trail_pos(int32_t pen_q12, int k)
{
    return pen_q12 - (int32_t)k * BOOT_ANIM_TRAIL_GAP;
}

/* The wheel position pen `k` carries, spread evenly round it. */
static inline int boot_anim_trail_hue(int k)
{
    return k * (BOOT_ANIM_HUE_TURN / BOOT_ANIM_TRAILS);
}

typedef struct {
    int     hue;     /* wheel position; boot_anim_hue_rgb() wraps it */
    uint8_t bloom;   /* mix that far toward white                    */
    uint8_t glow;    /* mix that far up from the background          */
    uint8_t width;   /* pixels across                                */
} boot_anim_stroke_t;

/* BASE depends on position. Strongest pen wins outright rather than
 * summing: summing saturates wherever trails overlap, which is constantly,
 * smearing bands into one bright stretch. Hue mixed BY STRENGTH so a piece
 * halfway between two pens comes out halfway between their colours.
 * Falloff is linear, not squared: squared piles glow right behind the
 * head and is over almost at once, and a slow fade is the point of a
 * trail. */
static inline boot_anim_stroke_t boot_anim_stroke(int32_t along_q12,
                                                  int32_t pen_q12)
{
    boot_anim_stroke_t s;

    const int32_t base_along = along_q12 > BOOT_ANIM_ONE ?
                               BOOT_ANIM_ONE : along_q12;
    const int32_t base_glow  = 132 + ((base_along * 60) >> BOOT_ANIM_Q);
    const int32_t base_bloom = (base_along * 24) >> BOOT_ANIM_Q;
    const int base_hue = BOOT_ANIM_HUE_START +
                         (int)((along_q12 * BOOT_ANIM_HUE_SWEEP) >> BOOT_ANIM_Q);

    int32_t best = 0;
    int     best_hue = 0;

    for (int k = 0; k < BOOT_ANIM_TRAILS; k++) {
        const int32_t behind = boot_anim_trail_pos(pen_q12, k) - along_q12;
        if (behind < 0 || behind >= BOOT_ANIM_TRAIL_Q12) {
            continue;   /* this piece is ahead of that pen, or long past it */
        }
        const int32_t trail = 255 - ((behind * 255) >> BOOT_ANIM_TRAIL_SHIFT);
        if (trail > best) {
            best = trail;
            best_hue = boot_anim_trail_hue(k);
        }
    }

    /* Shift is cheaper, +1 ensures full brightness. */
    s.hue   = base_hue + ((best_hue * (best + 1)) >> 8);
    s.glow  = (uint8_t)(base_glow  + (((255 - base_glow) * (best + 1)) >> 8));
    s.bloom = (uint8_t)(base_bloom + (((90 - base_bloom) * (best + 1)) >> 8));
    s.width = best >= BOOT_ANIM_FAT_TRAIL ? BOOT_ANIM_FAT_WIDTH : 1;

    return s;
}

/*
 * The finale
 *
 * The camera keeps turning and the space keeps moving while the title
 * arrives - the keyframe table is the whole mechanism.
 *
 * boot_anim_finale_reach() is not a transform of the space: it is how far
 * the AXES have grown from their short, labelled length toward the
 * unbounded lines the floor already draws. Reusing
 * BOOT_ANIM_FADE_START_MS/BOOT_ANIM_MS, boot_anim_ink()'s own window, makes
 * the axes finish unbounding exactly as the picture disappears - one ending
 * rather than two.
 */

static inline uint8_t boot_anim_finale_reach(uint32_t now_ms)
{
    return tween_ease_out(tween_ramp(
        now_ms, BOOT_ANIM_FADE_START_MS, BOOT_ANIM_MS - BOOT_ANIM_FADE_START_MS));
}

/* Axes run well past the panel and let clipping do the work - RINGS
 * stays bounded, being the actual finite wave data, not a guide line.
 * Not shared with BOOT_ANIM_GRID_SPOKE_FAR_UNITS: no reason to couple
 * two lines by philosophy alone, though both need the same real margin
 * (500, confirmed safe up to this project's largest space scale).
 * Overflow headroom is real but not guarded here - gen_boot_anim_
 * timeline.py's validate() does it instead, at the point authored data
 * enters. */
#define BOOT_ANIM_AXIS_FAR_UNITS 500

/*
 * Entry points into boot_anim.c
 *
 * Declared here and defined in boot_anim.c, the same arrangement ui_draw_icon()
 * has at the bottom of ui.h: a declaration costs this header none of its
 * host-portability, and a second header for one function would be worse.
 */

/* Public, not just boot_anim_run()'s own inner loop: gfx.c's primitives
 * are host-portable, so a plain host binary can call gfx_init(), this,
 * and read gfx_framebuffer() back - the real firmware picture, not a
 * reimplementation. See tools/boot_anim_render_host.c. */
void boot_anim_draw_frame(uint32_t now_ms);

#ifdef ESP_PLATFORM
/* Runs pre-boot, post-gfx_init(). Yields frames for watchdog. Device-only:
 * adds real wall clock and gfx_present() to real panel. */
void boot_anim_run(void);
#endif
