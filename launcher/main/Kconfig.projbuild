## launcher/main/Kconfig.projbuild
```kconfig
menu "Launcher"

    choice LAUNCHER_BUILD_TYPE
        prompt "Build type"
        default LAUNCHER_RELEASE
        help
            What this build is for. Exactly one of these is ever true, so
            code can check CONFIG_LAUNCHER_DEVELOPMENT and know it means
            "not a release build" - not "development, or maybe something
            else nobody has named yet."

        config LAUNCHER_RELEASE
            bool "Release"
            help
                The product, and nothing else. No test suites, no profiling
                counters, no logging meant to be read over a serial console.
                This project does not do telemetry - nobody downstream is
                ever reading those numbers - so anything a developer alone
                would want is pure cost here: flash for the strings, cycles
                for the bookkeeping, for output that helps nobody. None of
                it ships in this build.

        config LAUNCHER_DEVELOPMENT
            bool "Development"
            help
                Turns on everything meant for someone AT the device or
                watching its serial console while working on it - frame
                timing, step counters, that kind of thing. Guard code with
                CONFIG_LAUNCHER_DEVELOPMENT, not CONFIG_LAUNCHER_SELFTEST,
                unless what it is actually gating is the test suites
                themselves - see LAUNCHER_SELFTEST below, which requires
                this rather than turning it on for you. Turn this on by itself for a build that wants
                the profiling and logging without the test suites too.

    endchoice

    config LAUNCHER_SELFTEST
        bool "Include the on-device test suites"
        default n
        depends on LAUNCHER_DEVELOPMENT
        help
            Compiles the test suites into the firmware and runs them at boot,
            before the shell starts.

            Off by default, so a normal build carries no test code at all.
            The suites draw to the framebuffer and drive the panel, which is
            harmless in a diagnostics build and unacceptable in a shipped one,
            and test hooks in a release image are a liability rather than a
            feature.

            Turn this on through the diagnostics build rather than by hand:

                ./test/run_device_tests.sh

            which builds this variant into its own directory, flashes it,
            collects the results over the serial console and exits non-zero if
            anything failed.

    config LAUNCHER_SELFTEST_AUTORUN
        bool "Run the on-device test suites automatically at boot"
        depends on LAUNCHER_SELFTEST
        default n
        help
            LAUNCHER_SELFTEST above compiles the suites in; this decides
            whether they also RUN automatically at boot, versus sitting
            compiled-in until triggered on demand from the Diagnostics app's
            toggle screen.

            Off by default. The suite count has grown well past the "roughly
            half a second" boot/selftest.c's own comment once described, so
            paying that cost on every boot of an interactive diagnostics
            session - just to check the POST report or flip a toggle - makes
            the build too slow to use for anything else. Turn this on only
            for an automated harness that needs the suites to run themselves,
            such as tools/report_test_results.sh, which layers
            sdkconfig.defaults.diag_autorun on top of sdkconfig.defaults.diag
            for exactly that reason.

    choice LAUNCHER_SELFTEST_SCOPE
        prompt "Which suites the self-test image carries"
        depends on LAUNCHER_SELFTEST
        default LAUNCHER_SELFTEST_SCOPE_FULL
        help
            LAUNCHER_SELFTEST above compiles the suites in; this decides
            WHICH of them get compiled at all. Scoped around what a run
            READS rather than around folders - see the two entries below.

            Full is the default and must stay that way: a scope is opt-in
            precisely so that coverage can never shrink by accident.

        config LAUNCHER_SELFTEST_SCOPE_FULL
            bool "Full - every suite"
            help
                Every suite in the tree, shell-owned and app-owned alike.
                This is what run_device_tests.sh and report_test_results.sh
                want: a gate is only a gate if it runs everything.

        config LAUNCHER_SELFTEST_SCOPE_PERF
            bool "Perf - sand's frame-budget suite and the scenes it measures"
            help
                Only what a sand performance capture reads:
                suite_sand_perf.c plus the scene builders it calls. Nothing
                else is compiled, so their .bss and .text are gone from the
                image - which is what buys back the static-RAM headroom a
                capture needs.

                It is also a build closer to release layout in the 32 KB
                instruction cache. That is a better instrument on a
                fetch-bound workload, but it means absolute numbers from a
                perf-scoped capture compare only within that capture or
                other perf-scoped captures, never against an unscoped one.

                NOT a test gate: it drops behaviour coverage on purpose.
                Never take a merge decision from a perf-scoped run.

    endchoice

    config LAUNCHER_GFX_QSPI_80MHZ
        bool "Drive the panel's QSPI bus at 80 MHz instead of 40"
        default n
        help
            Halves the time a full frame spends on the bus: 8.2 ms at 80 MHz
            against 16.5 at 40, and a measured full present of 17.6 ms says
            there is no software slack left at the lower clock. The display
            transfer is the largest single cost in a frame, so this is the
            biggest lever on the board.

            There is no in-between. The 80 MHz source's integer divider
            (n >= 2 floor) resolves to exactly 40 or 80, so this is a bool
            rather than a frequency.

            OFF BY DEFAULT BECAUSE IT IS NOT PROVEN. 80 MHz produces
            corner-shaped artifacts - corruption at the START of a transfer
            rather than noise across the frame. Raising the pad drive below
            makes them rare rather than routine, which points at an edge-rate
            or setup-margin problem at the panel's receiver rather than a
            bandwidth ceiling, but rare is not gone. A redraw over the affected
            area clears it, so nothing latches.

            IF YOU TURN THIS ON, the dirty-band thresholds in gfx.h were fitted
            to 40 MHz timings and are wrong until re-measured - some of the win
            leaks back otherwise.

    config LAUNCHER_GFX_QSPI_STRONG_PADS
        bool "Drive the QSPI pads at 40 mA instead of the 20 mA default"
        default n
        help
            Raises drive capability on the four data lines and the clock,
            sharpening their edges. Applied after spi_bus_initialize(), which
            is what configures those pads - set before it and the driver
            overwrites it.

            Only meaningful alongside the 80 MHz option above: at 40 MHz the
            link has margin to spare and this changes nothing measurable. At
            80 it took the corner artifacts from routine to hard to provoke,
            which is the evidence that the failure is about edge rate rather
            than bandwidth.

endmenu
```
